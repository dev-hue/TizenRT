## apps/examples/tfmicro_ice_maker/Kconfig
```kconfig
#
# For a description of the syntax of this configuration file,
# see kconfig-language at https://www.kernel.org/doc/Documentation/kbuild/kconfig-language.txt
#

config EXAMPLES_ICE_MAKER_TFMICRO
	bool "\"Ice maker\" TF Micro example"
	default n
	---help---
		Enable the \"Ice maker\" TF Micro example

config USER_ENTRYPOINT
	string
	default "tfmicro_ice_maker_main" if ENTRY_ICE_MAKER_TFMICRO
```

## external/tfmicro/Kconfig
```kconfig
#
# For a description of the syntax of this configuration file,
# see kconfig-language at https://www.kernel.org/doc/Documentation/kbuild/kconfig-language.txt
#

config EXTERNAL_TFMICRO
	bool "Tensorflow Lite for Microprocessor"
	default n
	---help---
		Enables the Tensorflow lite for Microprocessor
```
